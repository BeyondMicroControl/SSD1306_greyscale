#pragma once

//TINY4KOLED
#ifndef TINY4KOLED_WIDTH
#define TINY4KOLED_WIDTH  128
#endif
#ifndef TINY4KOLED_HEIGHT
#define TINY4KOLED_HEIGHT 64
#endif
#ifndef TINY4KOLED_MOD
#define TINY4KOLED_MOD
#endif
#if TINY4KOLED_HEIGHT == 64
#define TINY4KOLED_DIV 2
#endif
#if TINY4KOLED_HEIGHT == 48
#define TINY4KOLED_DIV 3
#endif
#if TINY4KOLED_HEIGHT == 32
#define TINY4KOLED_DIV 4
#endif
#if TINY4KOLED_HEIGHT == 16
#define TINY4KOLED_DIV 5
#endif

#define TINY4KOLED_PAGES (TINY4KOLED_HEIGHT >> 3)
#define PASTE(a,b) a##b
#define CONCAT(a,b) PASTE(a,b)
#define MAKE_NAME(s1, s2, s3, s4, s5) CONCAT(CONCAT(CONCAT(CONCAT(s1, s2), s3), s4), s5)
#define TINY4KOLED_INI MAKE_NAME(tiny4koled_init_,TINY4KOLED_WIDTH,x,TINY4KOLED_HEIGHT,TINY4KOLED_MOD)

// SCREEN FLIP INTERRUPT

#ifndef _SWITCH_DISP_INTERRUPT_FLAG
  #define _SWITCH_DISP_INTERRUPT_FLAG g_toggle_req
#endif

#if defined(TEENSYDUINO) || defined(ARDUINO_TEENSY40) || defined(ARDUINO_TEENSY41)
  #define USE_TEENSY_INTERVALTIMER 1
  #define BUTTON_INPUT
#endif

// ---------------- I2C speed ----------------
#ifndef I2C_HZ
  #define I2C_HZ 1000000UL
#endif


// ---------------- PWM config (slot-based) ----------------
// A is shown for A_SLOTS slots, B for the remaining slots.
// Example TOTAL_SLOTS=4, A_SLOTS=3 => 75% / 25% duty, 4 perceived levels.
static constexpr uint16_t PWM_HZ      = 68;
static constexpr uint8_t  TOTAL_SLOTS = 3;
static constexpr uint8_t  A_SLOTS     = 2;
static_assert(A_SLOTS > 0 && A_SLOTS < TOTAL_SLOTS, "A_SLOTS must be 1..TOTAL_SLOTS-1");

static constexpr uint16_t SLOT_HZ = PWM_HZ * TOTAL_SLOTS;

#if defined(USE_TEENSY_INTERVALTIMER)
  // IntervalTimer uses microseconds. Rounded.
  static constexpr uint32_t SLOT_US = (1000000UL + (SLOT_HZ / 2)) / SLOT_HZ;
#endif

// RTC runs from 32.768 kHz clock in INT32K mode on ATtiny3224
static constexpr uint16_t RTC_HZ      = 32768;
static constexpr uint16_t TICKS_PER_SLOT = (RTC_HZ + (SLOT_HZ/2)) / SLOT_HZ; // rounded
static_assert(TICKS_PER_SLOT >= 2, "TICKS_PER_SLOT too small; lower SLOT_HZ or increase prescaler");

// ---------------- ISR <-> loop flags ----------------
volatile uint8_t  g_slot       = 0;
volatile uint8_t  _SWITCH_DISP_INTERRUPT_FLAG = 0;
volatile uint16_t g_isr_count  = 0;

// ---------------- Timebase backend (slot tick) ----------------
// Slot tick frequency: SLOT_HZ (= PWM_HZ * TOTAL_SLOTS)

#if defined(USE_TEENSY_INTERVALTIMER)
  #include <IntervalTimer.h>
  static IntervalTimer g_slotTimer;

  // Keep your existing integer PWM_HZ for ATtiny if you want.
  // Teensy-only target:
  //static constexpr float PWM_HZ_F  = 68.8833f;
   static constexpr float PWM_HZ_F  = 68.78f;
  static constexpr float SLOT_HZ_F = PWM_HZ_F * (float)TOTAL_SLOTS;
  static constexpr float SLOT_US_F = 1000000.0f / SLOT_HZ_F;  // 4839.600... us


  static void slot_isr()
  {
    g_isr_count++;

    uint8_t s = g_slot + 1;
    if (s >= TOTAL_SLOTS) s = 0;
    g_slot = s;

    if (s == A_SLOTS || s == 0) _SWITCH_DISP_INTERRUPT_FLAG = 1;
  }

  static void rtc_init_slots()
  {
    g_slot = 0;
    _SWITCH_DISP_INTERRUPT_FLAG = 0;
    g_isr_count = 0;

    // Pass float microseconds for higher precision
    g_slotTimer.begin(slot_isr, SLOT_US_F);
  }


#else
  // AVR / ATtiny path only
  #include <avr/interrupt.h>

  static bool rtc_wait_sync(uint16_t max_loops = 60000)
  {
  #if defined(RTC_STATUS)
    while (RTC.STATUS && max_loops--) { }
    return (RTC.STATUS == 0);
  #else
    (void)max_loops;
    return true;
  #endif
  }

  static void rtc_init_slots()
  {
    RTC.CTRLA = 0;
    rtc_wait_sync();

  #if defined(RTC_CLKSEL_INT32K_gc)
    RTC.CLKSEL = RTC_CLKSEL_INT32K_gc;
  #endif
    rtc_wait_sync();

    RTC.PER = (uint16_t)(TICKS_PER_SLOT - 1);
    RTC.CNT = 0;
    rtc_wait_sync();

  #if defined(RTC_OVF_bm)
    RTC.INTFLAGS = RTC_OVF_bm;
    RTC.INTCTRL  = RTC_OVF_bm;
  #endif

  #if defined(RTC_PRESCALER_DIV1_gc)
    RTC.CTRLA = RTC_RTCEN_bm | RTC_PRESCALER_DIV1_gc;
  #else
    RTC.CTRLA = RTC_RTCEN_bm;
  #endif
    rtc_wait_sync();

    sei();
  }

  ISR(RTC_CNT_vect)
  {
  #if defined(RTC_OVF_bm)
    RTC.INTFLAGS = RTC_OVF_bm;
  #endif
    g_isr_count++;

    uint8_t s = g_slot + 1;
    if (s >= TOTAL_SLOTS) s = 0;
    g_slot = s;

    if (s == A_SLOTS || s == 0) {
      _SWITCH_DISP_INTERRUPT_FLAG = 1;
    }
  }

#endif

#include <Tiny4kOLED.h>

const uint8_t font_2b12_widths[] PROGMEM = { 3, 4, 7, 6, 9, 7, 2, 3, 3, 5, 6, 2, 3,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 2, 4 };
const uint8_t font_2b12_offsets_cols[] PROGMEM = { 0, 4, 9, 17, 24, 34, 42, 45, 49, 53, 59, 66, 69,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 558, 561 };
const uint16_t font_2b12_offsets_bytes[] PROGMEM = { 0, 12, 27, 51, 72, 102, 126, 135, 147, 159, 177, 198, 207,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 1674, 1683 };
const char font_2b12_characters[] PROGMEM = {'!','"','#','$','%','&','\'','(',')','*','+',',','-','.','/','0','1','2','3','4','5','6','7','8','9',':',';','<','=','>','?','@','A','B','C','D','E','F','G','H','I','J','K','L','M','N','O','P','Q','R','S','T','U','V','W','X','Y','Z','[','\\',']','^','_','`','a','b','c','d','e','f','g','h','i','j','k','l','m','n','o','p','q','r','s','t','u','v','w','x','y','z','{','|','}','~','\'','}'};


const uint8_t font_2b12_data[] PROGMEM = {
    0x05, 0x50, 0x40, 0x0F, 0xF9, 0xC0, 0x05, 0x00, 0x40, 0x00, 0x00, 0x00, 0x05, 0x00, 0x00, 0x0F,
  0x40, 0x00, 0x04, 0x00, 0x00, 0x0F, 0x40, 0x00, 0x00, 0x00, 0x00, 0x00, 0x4C, 0x00, 0x00, 0xDF,
  0xC0, 0x0F, 0xFD, 0x00, 0x05, 0xDF, 0xC0, 0x0F, 0xFD, 0x40, 0x05, 0xCC, 0x00, 0x00, 0x40, 0x00,
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  0x00, 0x00, 0x00, 0x08, 0x00, 0x14, 0x0F, 0xA6, 0xB8, 0x06, 0xFF, 0xE0, 0x00, 0x18, 0x00
    };
